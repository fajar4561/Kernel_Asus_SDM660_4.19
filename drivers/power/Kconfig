## drivers/power/Kconfig
```kconfig
config AUTOCUT_CHARGER
	bool "AutoCut Charger"
	default n
	help
	  Disable battery charging if battery capacity at 100.
	  
source "drivers/power/avs/Kconfig"
source "drivers/power/reset/Kconfig"
source "drivers/power/supply/Kconfig"
```
